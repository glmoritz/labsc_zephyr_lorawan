## boards/blackpill_f411ce.conf
```kconfig
# Board-scoped Kconfig for blackpill_f411ce (STM32F411CE).
CONFIG_GPIO=y
CONFIG_SPI=y
CONFIG_SENSOR=y
CONFIG_MAX6675=y
```

## boards/esp32c6_devkitc_esp32c6_hpcore.conf
```kconfig
# Board-scoped Kconfig for esp32c6_devkitc/esp32c6/hpcore.
#
# SPI and GPIO are already `select`ed by the SEMTECH_LR11XX driver (it becomes
# default-y once the overlay instantiates a `semtech,lr1121` node), so nothing
# is strictly required here. These are stated explicitly for visibility and as
# the place to add any ESP32-C6-specific overrides later.
CONFIG_GPIO=y
CONFIG_SPI=y

# MAX6675 thermocouple readers (two nodes on the shared spi2 bus).
CONFIG_SENSOR=y
CONFIG_MAX6675=y
```
